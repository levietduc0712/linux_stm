// SPDX-License-Identifier: (GPL-2.0-only OR BSD-2-Clause)
/*
 * Device Tree overlay example for the experimental Rust I2C driver
 * on STM32MP257F-DK.
 *
 * This overlay is NOT required to load the Rust module — the module
 * searches the device tree directly via of_find_compatible_node().
 *
 * However, this file documents the existing I2C DT structure that
 * the Rust driver reads from, and shows how you could create an
 * overlay if you wanted to add or modify an I2C node.
 *
 * On the STM32MP257F-DK, I2C nodes are already defined in:
 *   arch/arm64/boot/dts/st/stm32mp251.dtsi
 * and enabled/configured in:
 *   arch/arm64/boot/dts/st/stm32mp257f-dk.dts
 *
 * The Rust driver binds to: compatible = "st,stm32mp25-i2c"
 * which matches i2c1 through i2c8 on the STM32MP25x SoC.
 */

/dts-v1/;
/plugin/;

/*
 * Example: Enable I2C3 on STM32MP257F-DK for use with the Rust driver.
 *
 * The Rust experiment module will find the FIRST "st,stm32mp25-i2c" node
 * that is enabled (status = "okay") in the device tree. On the DK board,
 * i2c2 is already enabled by default.
 *
 * If you want to experiment with a different I2C controller (e.g., I2C3),
 * you can use this overlay. Note that you also need appropriate pinctrl
 * entries for the specific board.
 */

&i2c3 {
	pinctrl-names = "default", "sleep";
	/* Replace with actual pinctrl phandles for your board */
	/* pinctrl-0 = <&i2c3_pins_a>; */
	/* pinctrl-1 = <&i2c3_sleep_pins_a>; */
	i2c-scl-rising-time-ns = <185>;
	i2c-scl-falling-time-ns = <20>;
	clock-frequency = <100000>;
	status = "okay";
};

/*
 * Reference: Existing I2C1 node from stm32mp251.dtsi
 * (DO NOT include this in an actual overlay — it's here for documentation)
 *
 *   i2c1: i2c@40120000 {
 *       compatible = "st,stm32mp25-i2c";
 *       reg = <0x40120000 0x400>;
 *       interrupt-names = "event";
 *       interrupts = <GIC_SPI 108 IRQ_TYPE_LEVEL_HIGH>;
 *       clocks = <&rcc CK_KER_I2C1>;
 *       resets = <&rcc I2C1_R>;
 *       #address-cells = <1>;
 *       #size-cells = <0>;
 *       dmas = <&hpdma 27 0x20 0x00003012>,
 *              <&hpdma 28 0x20 0x00003021>;
 *       dma-names = "rx", "tx";
 *       i2c-analog-filter;
 *       status = "disabled";
 *   };
 *
 * The I2C register block is 0x400 bytes. Key registers:
 *   Offset  Name     Description
 *   0x00    CR1      Control Register 1
 *   0x04    CR2      Control Register 2
 *   0x08    OAR1     Own Address Register 1
 *   0x0C    OAR2     Own Address Register 2
 *   0x10    TIMINGR  Timing Register
 *   0x18    ISR      Interrupt and Status Register
 *   0x1C    ICR      Interrupt Clear Register
 *   0x20    PECR     PEC Register
 *   0x24    RXDR     Receive Data Register
 *   0x28    TXDR     Transmit Data Register
 */
